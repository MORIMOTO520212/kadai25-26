/****************************************************************************/
/*																			*/
/*		DH11湿温度センサデータ受信 Base Class									*/
/*																			*/
/*	■制約事項																*/
/*		・DHT11Read関数を呼び出した後，次にDHT11Read関数を呼び出す迄に2秒以上の	*/
/*		　間隔を空けること．													*/
/*		　DHT11Read関数は非リエントラントである．								*/
/*		・ライセンスはGPLに準じるものとする．									*/
/*																			*/
/*											東京国際工科専門職大学　荒金匡德	*/
/****************************************************************************/
/* #000		2021/01/08 初版										荒金匡德		*/
/* #001     2021/01/09 温度を実数で保持するよう修正				荒金匡徳		*/
/****************************************************************************/
#include	"DHT11.h"

// コンストラクタ
DHT11::DHT11(void){
	this->humidity_H = this->humidity_L = this->temperature_H = this->temperature_L = 0xFF;
}

///////////////////////////////////////////////////////////
//    DHT11 温湿度取得関数
//    呼出形式：int		DHT11Read( void);
//    引　数：なし
//    戻り値：受信ステータス（0:正常受信／1:通信エラー）
//　　機　能：DHT11より温度・湿度データを読み出す．
//       　  アプリケーションは読み出したデータを次のメソッドにて
//		   　取得する．
//			　getTemperature_H	温度（小数点以上）
//			　getTemperature_L	温度（小数点未満）
//			　getHumidity_H		湿度（小数点以上）
//			　getHumidity_L		湿度（小数点未満）
///////////////////////////////////////////////////////////
int	DHT11::DHT11Read( void){
	UCHR	data[5];
	int		ret = 0;			// リターンコード(0:正常，1:通信エラー)
	TCCR0A = 0b00000000;		// 波形出力無し
	TCCR0B = 0B00000010;		// プリスケーラ8分周
	TIMSK0 = 0b00000000;		// タイマ割込み禁止

	// DHT11にスタートビット送信
	SDA_H;							// SDAにHを出力
	SDA_OUT;						// SDAを出力に設定
	_delay_ms(50);					// 50ms待ち
	SDA_L;							// SDAにLを出力
	_delay_ms(19);					// 19ms待ち
	SDA_H;							// SDAにHを出力
	//DHT11からのスタート信号待ち
	SDA_IN;							// PORTB Bit1(SDA)を入力に設定
	WAIT_SDA_L;						// SDAがLになるまで待つ
	// DHT11のスタート信号(80μsのL-H)待ち
	WAIT_SDA_H;						// SDAがHになるまで待つ
	WAIT_SDA_L;						//　SDAがLになるまで待つ
	// 40Bitのデータを受信
	for( int bit_cnt = 0; bit_cnt < 40; bit_cnt++){
		cli();
		WAIT_SDA_H;					// SDAがHになるまで待つ
		USHRT tcnt0_1 = TCNT0;		// SDAがHになった時刻をtcnt0_1に保存
		WAIT_SDA_L;					// SDAがLになるまで待つ
		USHRT tcnt0_2 = TCNT0;		// SDAがLになった時刻をtcnt0_2に保存
		sei();						// 割込み禁止
		data[bit_cnt/8] <<= 1;		// 受信データバッファを1ビット左シフト
		if( tcnt0_2 < tcnt0_1){		// タイマカウンタがオーバーフローしていた場合
			tcnt0_2 += 0x0100;		// オーバーフロー後のカウンタ値に0x100を加算
		}
		if( (tcnt0_2-tcnt0_1) > 97){// パルス幅が48.5μsより大きければ
			data[bit_cnt/8] |= 1;	// 1を受信
		}							//パルス幅が48.5μsより小さければ0を受信
	}
	WAIT_SDA_H;						// SDAのSTOPビットを待つ
	this->humidity_H    = data[0];	// メンバ変数に湿度（小数点以上）を保存
	this->humidity_L    = data[1];	// メンバ変数に湿度（小数点未満）を保存
	this->temperature_H = data[2];	// メンバ変数に温度（小数点以上）を保存
	this->temperature_L = data[3];	// メンバ変数に温度（小数点未満）を保存
									// 温度の小数点以上と未満のデータを合成する．				#001
	temperature = (float)this->temperature_H + (float)((this->temperature_L & 0x7F)/10.0);//#001
	if( (this->temperature_L & 0x80) != 0){// 氷点下Bitが立っていたら							#001
		this->temperature *= (-1.0);// 温度データに-1を乗算する								#001
	}																					//  #001
	if(( data[0] + data[1] + data[2] + data[3]) != data[4]){// チェックサム照合
		ret = 1;					// チェックサムNGなら通信エラーとする
	}
	return ret;
}

///////////////////////////////////////////////////////////
//    DHT11 温度読出関数（実数）#001(新規）
//    呼出形式：float	getTemperature( void);
//    引　数：なし
//    戻り値：温度データ（実数値）
//　　機　能：DHT11より読み出した温度データを取得する．
//       　  センサより値が1度も読み出せていない場合は0xFFが
//		   　戻り値で返却される．
///////////////////////////////////////////////////////////
float	DHT11::getTemperature(void){
	return temperature;
}

///////////////////////////////////////////////////////////
//    DHT11 温度読出関数（小数点以上）
//    呼出形式：UCHR		getTemperature_H( void);
//    引　数：なし
//    戻り値：温度データ（小数点以上の値）
//　　機　能：DHT11より読み出した温度データを取得する．
//       　  センサより値が1度も読み出せていない場合は0xFFが
//		   　戻り値で返却される．
///////////////////////////////////////////////////////////
UCHR	DHT11::getTemperature_H(void){
	return temperature_H;
}

///////////////////////////////////////////////////////////
//    DHT11 温度読出関数（小数点未満）
//    呼出形式：UCHR		getTemperature_L( void);
//    引　数：なし
//    戻り値：温度データ（小数点未満の値）
//　　機　能：DHT11より読み出した温度データを取得する．
//       　  センサより値が1度も読み出せていない場合は0xFFが
//		   　戻り値で返却される．
///////////////////////////////////////////////////////////
UCHR	DHT11::getTemperature_L(void){
	return	temperature_L;
}

///////////////////////////////////////////////////////////
//    DHT11 湿度読出関数（小数点以上）
//    呼出形式：UCHR		getHumidity_H( void);
//    引　数：なし
//    戻り値：温度データ（小数点以上の値）
//　　機　能：DHT11より読み出した湿度データを取得する．
//       　  センサより値が1度も読み出せていない場合は0xFFが
//		   　戻り値で返却される．
///////////////////////////////////////////////////////////
UCHR	DHT11::getHumidity_H(void){
	return	humidity_H;
}

///////////////////////////////////////////////////////////
//    DHT11 湿度読出関数（小数点未満）
//    呼出形式：UCHR		getHumidity_L( void);
//    引　数：なし
//    戻り値：温度データ（小数点未満の値）
//　　機　能：DHT11より読み出した湿度データを取得する．
//       　  センサより値が1度も読み出せていない場合は0xFFが
//		   　戻り値で返却される．
///////////////////////////////////////////////////////////
UCHR	DHT11::getHumidity_L(void){
	return humidity_L;				// 湿度データ（小数点未満）読出し
}